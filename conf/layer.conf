## conf/layer.conf
```bitbake
BBPATH .= ":${LAYERDIR}"

BBFILES += "${LAYERDIR}/recipes-*/*/*.bb \
            ${LAYERDIR}/recipes-*/*/*.bbappend"

BBFILE_COLLECTIONS += "meteorpi"
BBFILE_PATTERN_meteorpi = "^${LAYERDIR}/"
BBFILE_PRIORITY_meteorpi = "1"
LAYERVERSION_meteorpi = "1"
LAYERSERIES_COMPAT_meteorpi = "dunfell"
```
